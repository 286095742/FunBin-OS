## FunBin/Config.in
```kconfig
source "$BR2_EXTERNAL_FUNBIN_PATH/package/mednafen/Config.in"
source "$BR2_EXTERNAL_FUNBIN_PATH/package/fkgpiod/Config.in"
source "$BR2_EXTERNAL_FUNBIN_PATH/package/retrofe/Config.in"
source "$BR2_EXTERNAL_FUNBIN_PATH/package/PCSX-ReARMed/Config.in"
source "$BR2_EXTERNAL_FUNBIN_PATH/package/FCEUX/Config.in"
source "$BR2_EXTERNAL_FUNBIN_PATH/package/gnuboy/Config.in"
source "$BR2_EXTERNAL_FUNBIN_PATH/package/picodrive/Config.in"
source "$BR2_EXTERNAL_FUNBIN_PATH/package/PocketSNES/Config.in"
source "$BR2_EXTERNAL_FUNBIN_PATH/package/gpsp/Config.in"
source "$BR2_EXTERNAL_FUNBIN_PATH/package/dmtx-utils/Config.in"
source "$BR2_EXTERNAL_FUNBIN_PATH/package/ProdScreens/Config.in"
source "$BR2_EXTERNAL_FUNBIN_PATH/package/fonts-droid/Config.in"
source "$BR2_EXTERNAL_FUNBIN_PATH/package/libini/Config.in"
source "$BR2_EXTERNAL_FUNBIN_PATH/package/libopk/Config.in"
source "$BR2_EXTERNAL_FUNBIN_PATH/package/libxdgmime/Config.in"
source "$BR2_EXTERNAL_FUNBIN_PATH/package/gmenu2x/Config.in"
source "$BR2_EXTERNAL_FUNBIN_PATH/package/agg/Config.in"
source "$BR2_EXTERNAL_FUNBIN_PATH/package/fluidlite/Config.in"
source "$BR2_EXTERNAL_FUNBIN_PATH/package/libmikmod/Config.in"
source "$BR2_EXTERNAL_FUNBIN_PATH/package/commander/Config.in"
source "$BR2_EXTERNAL_FUNBIN_PATH/package/bibi/Config.in"
```

## FunBin/package/bibi/Config.in
```kconfig
config BR2_PACKAGE_BIBI
	bool "FunBoy 40a - bibi"
	default y
	help
	  Bomberman game in c with SDL, readapted for the FunBoy 40A.
```

## Recovery/package/fkgpiod/Config.in
```kconfig
config BR2_PACKAGE_FKGPIOD
	bool "FunBoy 40A GPIO daemon"
	default y
	help
	  The FunBin GPIO mapping utility.
```
